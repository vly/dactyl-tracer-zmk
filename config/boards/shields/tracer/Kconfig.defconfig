## config/boards/shields/tracer/Kconfig.defconfig
```kconfig
if SHIELD_TRACER_RIGHT

    config ZMK_KEYBOARD_NAME
        default "Tracer"

    config ZMK_SPLIT_BLE_ROLE_CENTRAL
        default y
endif

if SHIELD_TRACER_LEFT

    config ZMK_KEYBOARD_NAME
        default "Tracer Left"

endif

if SHIELD_TRACER_LEFT || SHIELD_TRACER_RIGHT

    config ZMK_SPLIT
        default y

endif
```

## config/boards/shields/tracer/Kconfig.shield
```kconfig
config SHIELD_TRACER_RIGHT
	def_bool $(shields_list_contains,tracer_right)

config SHIELD_TRACER_LEFT
    def_bool $(shields_list_contains,tracer_left)
```
